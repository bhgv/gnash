## Config.in
```kconfig
config BR2_PACKAGE_GNASH
        bool "gnash"
#        select BR2_PACKAGE_ALSA_LIB
#        select BR2_PACKAGE_ZLIB
        select BR2_PACKAGE_LIBCURL
        help
          gnash - GNU Flash Player.
```
